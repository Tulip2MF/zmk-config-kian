## config/boards/shield/kian/Kconfig.defconfig
```kconfig
if SHIELD_KIAN_LEFT

config ZMK_KEYBOARD_NAME
	default "Kian"


endif

if SHIELD_Kian_RIGHT

config ZMK_KEYBOARD_NAME
	default "Kian Right"
config ZMK_SPLIT_BLE_ROLE_CENTRAL
	default y

	
endif

if SHIELD_KIAN_LEFT || SHIELD_KIAN_RIGHT

config ZMK_SPLIT
	default y
endif
```

## config/boards/shield/kian/Kconfig.shield
```kconfig
config SHIELD_FIFI_LEFT
	def_bool $(shields_list_contains,kian_left)

config SHIELD_FIFI_RIGHT
	def_bool $(shields_list_contains,kian_right)
```
